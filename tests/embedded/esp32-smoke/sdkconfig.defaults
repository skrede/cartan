## tests/embedded/esp32-smoke/sdkconfig.defaults
```kconfig
# ESP-IDF defaults for the cartan compile-only smoke. Production firmware
# should tune these against its own real-time, power, and memory budget.

# Optimize for size by default — cartan's templated Eigen instantiations are
# the dominant flash contributor, and -Os reflects what an embedded user
# would typically pick.
CONFIG_COMPILER_OPTIMIZATION_SIZE=y

# Disable C++ exceptions to match a realistic embedded posture. cartan's
# checked factories route their success branches through the noexcept
# operator*, and cartan::expected::value() gates its throw on __cpp_exceptions,
# trapping through an overridable handler when exceptions are off. Firmware that
# wants a custom fault path defines CARTAN_ON_BAD_EXPECTED_ACCESS.
CONFIG_COMPILER_CXX_EXCEPTIONS=n
CONFIG_COMPILER_CXX_RTTI=n

# Float-only FPU — Eigen will use it; cartan templates default to float in
# the smoke, so this matches the instantiation footprint.
CONFIG_ESP_TASK_WDT_INIT=y
```
